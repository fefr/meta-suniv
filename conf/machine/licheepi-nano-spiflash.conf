## conf/machine/licheepi-nano-spiflash.conf
```bitbake
#@TYPE: Machine
#@NAME: lichee-pi-nano
#@DESCRIPTION: Machine configuration for the lichee-pi-nano, base on Allwinner F1C100s CPU
#https://github.com/linux-sunxi/meta-sunxi

require conf/machine/include/suniv.inc

#PREFERRED_VERSION_u-boot = "v2018.01%"
PREFERRED_PROVIDER_u-boot ?= "u-boot-suniv-spiflash"
PREFERRED_PROVIDER_virtual/bootloader ?= "u-boot-suniv-spiflash"

SPL_BINARY ?= "u-boot-sunxi-spiflash-with-spl.bin"

KERNEL_DEVICETREE = "suniv-f1c100s-licheepi-nano.dtb"
UBOOT_MACHINE = "licheepi_nano_spiflash_defconfig"
```

## conf/machine/licheepi-nano.conf
```bitbake
#@TYPE: Machine
#@NAME: lichee-pi-nano
#@DESCRIPTION: Machine configuration for the lichee-pi-nano, base on Allwinner F1C100s CPU
#https://github.com/linux-sunxi/meta-sunxi

require conf/machine/include/suniv.inc

PREFERRED_VERSION_u-boot = "v2018.01%"

KERNEL_DEVICETREE = "suniv-f1c100s-licheepi-nano.dtb"
#UBOOT_MACHINE = "licheepi_nano_defconfig"
UBOOT_MACHINE = "licheepi_nano_spiflash_defconfig"
```

## example/conf/bblayers.conf
```bitbake
# POKY_BBLAYERS_CONF_VERSION is increased each time build/conf/bblayers.conf
# changes incompatibly
POKY_BBLAYERS_CONF_VERSION = "2"

BBPATH = "${TOPDIR}"
BBFILES ?= ""

BBLAYERS ?= " \
  /your/path/to/meta \
  /your/path/to/meta-poky \
  /your/path/to/meta-yocto-bsp \
  /your/path/to/meta-openembedded/meta-oe \
  /your/path/to/meta-suniv \
  "
```
